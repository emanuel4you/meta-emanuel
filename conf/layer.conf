## conf/layer.conf
```bitbake
# We have a conf and classes directory, append to BBPATH
BBPATH .= ":${LAYERDIR}"
# We have recipes-* directories, add to BBFILESS
BBFILES += "${LAYERDIR}/recipes-*/*/*.bb ${LAYERDIR}/recipes-*/*/*.bbappend"

BBFILE_COLLECTIONS += "emanuel-layer"
BBFILE_PATTERN_emanuel-layer := "^${LAYERDIR}/"
BBFILE_PRIORITY_emanuel-layer = "40"

# Set a variable to get to the top of the metadata location
EMANUEL_BASE := '${@os.path.normpath("${LAYERDIR}/../")}'
```
